## main/Kconfig.projbuild
```kconfig
menu "Plugin manager"
    config USER_BUTTON
        bool "Use custom GPIO for factory reset button"
        default y

    config USER_BUTTON_GPIO
        int "GPIO pin number for factory reset button"
        default 3
        depends on USER_BUTTON
        help
            GPIO number for the factory reset button (Default 3).
            Hold for 3s = factory reset.

    config USER_BUTTON_LEVEL
        int "GPIO level when factory reset button is active"
        default 0
        depends on USER_BUTTON

    config RGB_LED_GPIO
        int "GPIO pin for the built-in RGB LED (WS2812)"
        default 48
        help
            GPIO number connected to the WS2812 RGB LED data pin.
            On most ESP32-S3 DevKit boards this is GPIO48.

    config SERIAL_UART_TX_PIN
        int "GPIO pin for UART TX (external)"
        default 4
        help
           GPIO number used for UART1 TX (Default 4)

    config SERIAL_UART_RX_PIN
        int "GPIO pin for UART RX (external)"
        default 5
        help
           GPIO number used for UART1 RX (Default 5)

    config ENABLE_WEBSERVER
        bool "Enable HTTP web server (/AXX, /ZXX commands and status page)"
        default y
        help
            Starts an HTTP server on port 80 once the device has an IP address.
            GET /AXX (A01..) sends acc,XX@ ; GET /ZXX sends zcc,XX@ ;
            GET / returns the list of LEDxxON/OFF states (confirmed by serial).
            No authentication. Disable to remove the whole feature from the build.

endmenu
```
